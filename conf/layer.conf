## conf/layer.conf
```bitbake
# We have a conf and classes directory, add to BBPATH
BBPATH .= ":${LAYERDIR}"

# We have recipes-* directories, add to BBFILES
BBFILES += "${LAYERDIR}/recipes-*/*/*.bb \
            ${LAYERDIR}/recipes-*/*/*.bbappend"

BBFILE_COLLECTIONS += "meta-fontTools"
BBFILE_PATTERN_meta-fontTools = "^${LAYERDIR}/"
BBFILE_PRIORITY_meta-fontTools = "6"

LAYERDEPENDS_meta-fontTools = "core"
LAYERSERIES_COMPAT_meta-fontTools = "mickledore"
```
